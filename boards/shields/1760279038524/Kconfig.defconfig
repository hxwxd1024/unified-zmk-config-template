## boards/shields/1760279038524/Kconfig.defconfig
```kconfig
if SHIELD_1760279038524_LEFT

config ZMK_KEYBOARD_NAME
    default "1760279038524"

endif

if SHIELD_1760279038524_LEFT || SHIELD_1760279038524_RIGHT

config ZMK_SPLIT
    default y

endif
```

## boards/shields/1760279038524/Kconfig.shield
```kconfig
config SHIELD_1760279038524_LEFT
    def_bool $(shields_list_contains,1760279038524_left)
config SHIELD_1760279038524_RIGHT
    def_bool $(shields_list_contains,1760279038524_right)
```

## boards/shields/fing_board/Kconfig.shield
```kconfig
config SHIELD_FING_BOARD_LEFT
    def_bool $(shields_list_contains,fing_board_left)
config SHIELD_FING_BOARD_RIGHT
    def_bool $(shields_list_contains,fing_board_right)
config SHIELD_FING_BOARD_DONGLE
    def_bool $(shields_list_contains,fing_board_dongle)
```
