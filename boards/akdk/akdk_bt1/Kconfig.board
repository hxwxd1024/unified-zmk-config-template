## boards/akdk/akdk_bt1/akdk_bt1_nrf52840_defconfig
```kconfig
# Enable MPU
CONFIG_PINCTRL=y
# enable GPIO
CONFIG_GPIO=y
CONFIG_BUILD_OUTPUT_UF2=y
CONFIG_MPU_ALLOW_FLASH_WRITE=y
CONFIG_FLASH=y
CONFIG_FLASH_PAGE_LAYOUT=y
CONFIG_FLASH_MAP=y
#CONFIG_ZMK_RGB_UNDERGLOW_HUE_START=160
#CONFIG_ZMK_RGB_UNDERGLOW_EFF_START=3
```

## boards/shields/fing_board/Kconfig.defconfig
```kconfig
# ---------------------------------------------------------
# 共通設定: 左右およびドングルすべてに適用
# ---------------------------------------------------------
if SHIELD_FING_BOARD_LEFT || SHIELD_FING_BOARD_RIGHT || SHIELD_FING_BOARD_DONGLE

# 名前は全シールドで統一しておくと管理が楽です
# Max 16 characters
config ZMK_KEYBOARD_NAME
    default "fing_board"

# 全てのパーツはSplitシステムの一部として動作
config ZMK_SPLIT
    default y

endif

# ---------------------------------------------------------
# ドングル固有設定 (Central)
# ---------------------------------------------------------
if SHIELD_FING_BOARD_DONGLE

config ZMK_SPLIT_ROLE_CENTRAL
    default y

# 左右の周辺機器(Peripheral)の数。Unibodyなら1、左右分割なら2
config ZMK_SPLIT_BLE_CENTRAL_PERIPHERALS
    default 2

# 推奨計算式: ZMK_SPLIT_BLE_CENTRAL_PERIPHERALS (2) + 接続したいデバイス数 (通常5)
config BT_MAX_CONN
    default 7

# BT_MAX_CONN と同じ値にする
config BT_MAX_PAIRED
    default 7

endif
```

## config/west.yml
```yaml
manifest:
  remotes:
    - name: zmkfirmware
      url-base: https://github.com/zmkfirmware
    - name: sekigon-gonnoc
      url-base: https://github.com/sekigon-gonnoc
    - name: janpfischer                            # <--- add this
      url-base: https://github.com/janpfischer     # <--- and this
  projects:
    - name: zmk
      remote: zmkfirmware
      revision: v0.3
      import: app/west.yml
    - name: zmk-dongle-screen
      remote: janpfischer
      revision: main
  self:
    path: config
```
